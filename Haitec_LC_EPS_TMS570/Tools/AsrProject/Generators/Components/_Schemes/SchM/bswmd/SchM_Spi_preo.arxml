AUTOSAR XML (schema 3.0.1)
package /MICROSAR
  module config SchM_Rec: definition=SchM, implementation-config-variant=VARIANT-PRE-COMPILE  # Configuration of the SchM (BSW Scheduler) module.
    Spi_MainFunction_Handling (SchMMainFunctionMapping):
      SchMBswUsedOsEvent = SchM_AsyncEvent_1
      SchMBswUsedOsAlarm = SchM_Alarm_Async_1
      SchMBswActivationOffset = 0.003
      SchMPositionInTask = 0
      SchMTaskConfigurationRef = SchM_AsyncTask_1
    Spi_MainFunction_Driving (SchMMainFunctionMapping):
      SchMBswUsedOsEvent = SchM_AsyncEvent_1
      SchMBswUsedOsAlarm = SchM_Alarm_Async_1
      SchMBswActivationOffset = 0.003
      SchMPositionInTask = 1
      SchMTaskConfigurationRef = SchM_AsyncTask_1
