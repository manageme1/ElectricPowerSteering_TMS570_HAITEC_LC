AUTOSAR XML (schema 3.0.1)
package /MICROSAR
  module config SchM_Rec: definition=SchM, implementation-config-variant=VARIANT-PRE-COMPILE  # Configuration of the SchM (BSW Scheduler) module.
    PduR_MainFunction (SchMMainFunctionMapping):
      SchMBswUsedOsEvent = SchM_AsyncEvent_1
      SchMBswUsedOsAlarm = SchM_Alarm_Async_1
      SchMBswActivationOffset = 0.006
      SchMPositionInTask = 18
      SchMTaskConfigurationRef = SchM_AsyncTask_1
