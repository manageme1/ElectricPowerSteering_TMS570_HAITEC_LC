AUTOSAR XML (schema 3.0.1)
package /MICROSAR
  module config SchM_Rec: definition=SchM, implementation-config-variant=VARIANT-PRE-COMPILE  # Configuration of the SchM (BSW Scheduler) module.
    10 x SchMMainFunctionMapping, all with SchMBswUsedOsEvent=SchM_AsyncEvent_1, SchMBswUsedOsAlarm=SchM_Alarm_Async_1, SchMBswActivationOffset=0.004, SchMTaskConfigurationRef=SchM_AsyncTask_1:
      NmOsek_MainFunction_0: SchMPositionInTask=35
      NmOsek_MainFunction_1: SchMPositionInTask=36
      NmOsek_MainFunction_2: SchMPositionInTask=37
      NmOsek_MainFunction_3: SchMPositionInTask=38
      NmOsek_MainFunction_4: SchMPositionInTask=39
      NmOsek_MainFunction_5: SchMPositionInTask=40
      NmOsek_MainFunction_6: SchMPositionInTask=41
      NmOsek_MainFunction_7: SchMPositionInTask=42
      NmOsek_MainFunction_8: SchMPositionInTask=43
      NmOsek_MainFunction_9: SchMPositionInTask=44
