AUTOSAR XML (schema 3.0.1)
package /MICROSAR
  module config SchM_Rec: definition=SchM, implementation-config-variant=VARIANT-PRE-COMPILE  # Configuration of the SchM (BSW Scheduler) module.
    TcpIpXcp_MainFunction (SchMMainFunctionMapping):
      SchMBswUsedOsEvent = SchM_SyncEvent_1
      SchMBswUsedOsAlarm = SchM_Alarm_Sync_1
      SchMBswActivationOffset = 0.004
      SchMPositionInTask = 74
      SchMTaskConfigurationRef = SchM_SyncTask_1
