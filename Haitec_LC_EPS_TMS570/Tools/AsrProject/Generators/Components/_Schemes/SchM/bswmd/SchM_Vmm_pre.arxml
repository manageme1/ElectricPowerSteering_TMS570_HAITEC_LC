AUTOSAR XML (schema 3.0.1)
package /MICROSAR
  module config SchM_Rec: definition=SchM, implementation-config-variant=VARIANT-PRE-COMPILE  # Configuration of the SchM (BSW Scheduler) module.
    Vmm (SchMModuleConfiguration): SchMModuleLiteral=Vmm, SchMModuleInclude=Vmm.h, SchMModuleConfigVersion=1.0.0, SchMModuleImplementationRef=Vmm_Impl
      SCHM_VMM_INSTANCE_0 (InstanceConfiguration): SchMInstanceLiteral=SCHM_VMM_INSTANCE_0
        VMM_EXCLUSIVE_AREA_0 (ExclusiveAreaConf):
          SchMExclusiveAreaLiteral = VMM_EXCLUSIVE_AREA_0
          SchMExclusiveAreaDescription = The exclusive area must lock interrupts if VMM could be interrupted by different BSW tasks (refer to TechnicalReference_Vmm for details)
