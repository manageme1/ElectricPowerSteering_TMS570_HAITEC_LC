AUTOSAR XML (schema 3.0.1)
package /MICROSAR
  module definition CanXcp: variants pre-compile/link-time/post-build
    container CanXcpGeneral
      enumeration CanXcpConfigurationVariant: set at pre-compile, origin=Vector Informatik GmbH  # Specifies the selected configuration variant for the CanXcp module
        Variant_1  # Precompile_Configuration
        Variant_2  # Linktime_Configuration
        Variant_3  # Postbuild_Configuration
      boolean CanXcpVersionInfoApi: set at pre-compile, origin=Vector Informatik GmbH, default-value=false  # Enables/disables the existence of the CanXcp_GetVersionInfo() API service true: CanXcp_GetVersionInfo() API service exists false: CanXcp_GetVersionInfo() API service does not exist
      boolean CanXcpDevErrorDetect: set at pre-compile, origin=Vector Informatik GmbH, default-value=false  # Switches the Development Error Detection and Notification on or off true: Development Error Detection and Notification on false: Development Error Detection and Notification off
      string CanXcpUserConfigFile [0..1]: set at pre-compile, origin=Vector Informatik GmbH  # A configuration file is generated by GENy. If you want to overwrite settings in the generated configuration file, you can specify a path to a user defined configuration file. The user defined configuration file will be included at the end of the generated file. Therefore definitions in the user defined configuration file can overwrite definitions in the generated configuration file. The contents of the user defined configuration file is copied to the end of <Bsw>_Cfg.h.
      boolean CanXcpProdErrorDetect: set at pre-compile, origin=Vector Informatik GmbH, default-value=false  # Switches the Production Error Detection and Notification on or off true: Production Error Detection and Notification on false: Production Error Detection and Notification off
      boolean CanXcpVariableDlc: set at pre-compile, origin=Vector Informatik GmbH
      boolean CanXcpMultiConnectionProtection: set at pre-compile, origin=Vector Informatik GmbH
      integer CanXcpStartAddress: set at pre-compile, origin=Vector Informatik GmbH
      boolean CanXcpUsePduInfoType [0..1]: set at , origin=Vector Informatik GmbH  # 'CanXcpUsePduInfoType' If this option is enabled, the functions CanXcp_RxIndication and CanXcp_TriggerTransmit are called as specified in AUTOSAR 3.x, with a pointer to a PduInfo structure as second argument . If disabled, a pointer to a buffer is passed as second parameter instead.
      container CanXcpChannelConfig [1..*]  # This container contains the configuration (parameters) of the bus channel(s). The channel parameter shall be harmonized within the whole communication stack.
        reference CanXcpComMChannelRef [0..1]: set at pre-compile, origin=Vector Informatik, destination=ComMChannel  # This is needed for GENy module activation of non-AUTOSAR components.
    container CanXcpConfig: multiple-configuration-container=true
      reference CanXcpEcuMConfigurationRef [0..1]: set at pre-compile, origin=Vector Informatik, destination=EcuMConfiguration  # Internaly reference used by loader
      container CanXcpChannel [0..*]  # Configuration of the CAN Xcp. This container is a MultipleConfigurationContainer, i.e. this container and its sub-containers exist once per configuration set.
        container CanXcpPdu [1..*]  # Contains PDU information. A PDU may be either a transmission PDU or a reception PDU.
          choice container CanXcpPduDirection  # A PDU is either transmit or receive
            container CanXcpRxPdu [0..1]  # This container specifies reception PDUs.
              reference CanXcpPduRef: set at pre-compile, origin=Vector Informatik GmbH, destination=CanIfRxPduConfig  # Reference to the external PDU definition.
            container CanXcpTxPdu [0..1]  # This container specifies transmission PDUs.
              reference CanXcpPduRef: set at pre-compile, origin=Vector Informatik GmbH, destination=CanIfTxPduConfig  # Reference to the external PDU definition.
  bsw implementation CanXcp_Impl: code-generator=cMICROSAR, programming-language=C, sw-major-version=01, sw-minor-version=06, sw-patch-version=02, preconfigured-configuration=CanXcp_Pre, recommended-configuration=CanXcp_Rec, vendor-specific-module-def=CanXcp
  module config CanXcp_Pre: definition=CanXcp
  module config CanXcp_Rec: definition=CanXcp
