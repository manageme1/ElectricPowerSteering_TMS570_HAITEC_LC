AUTOSAR XML (schema 3.0.1)
package /MICROSAR
  module config Xcp_Pre: definition=Xcp
    XcpGeneral: XcpUseAsrFileNames=false
