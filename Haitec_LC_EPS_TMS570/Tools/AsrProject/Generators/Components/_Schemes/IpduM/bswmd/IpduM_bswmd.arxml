AUTOSAR XML (schema 3.0.1)
package /MICROSAR
  bsw implementation IPduMplex_Impl: code-generator=GENy, programming-language=C, sw-major-version=1, sw-minor-version=3, sw-patch-version=2, vendor-id=30, ar-major-version=1, ar-minor-version=2, ar-patch-version=1, preconfigured-configuration=IPduMplex_Pre, recommended-configuration=IPduMplex_Rec, vendor-specific-module-def=IPduMplex
  module definition IPduMplex [0..1]: refined-module-def=IPduMplex, variants pre-compile/link-time/post-build  # Configuration of the IPduMplex (IPdu Multiplexer) module.
    container IPduMGeneral  # Contains the general configuration parameters of IPduMplex.
      float IPduMConfigurationTimeBase: set at pre-compile, default-value=0.01  # The period between successive ticks of AUTOSAR COM in seconds.
      boolean IPduMDevErrorDetect: set at pre-compile  # This parameter activates/deactivates the detection of development errors. It has to be de-activated for production code. True: error detection activated. False: error detection de-activated
      boolean IpduMVStdLibUsed: set at pre-compile, origin=Vector Informatik  # Set the check box to use the VSdtLib API (to set, clear and copy data elements in IpduM. Reset the check box to deactivate the feature. NOTE: The feature can be deactvated for Mcs12x, if the post build data is located e.g. in the GPAGE.
      boolean IPduMStaticPartExists: set at pre-compile  # This parameter allows optimizations in the case the multiplex I-PDU(s) will never be configured with static part(s). Note that this is a pre-compile option. If it is de-activated, it will not be possible to configure static parts after compilation. True: A static part may exist. False: A static part will never exist.
      boolean IPduMVersionInfoApi: set at pre-compile  # This parameter activates/de-activates the version information API. True: version information activated. False: version information de-activated
      string IPduMUserConfigFile [0..1]: set at pre-compile, origin=Vector Informatik  # This parameter configures a reference to a user defined configuration file. The conent of the user defined configuration file is included at the end of the generated IpduM_Cfg.h. It can be used to overwrite definitions.
      integer IPduMPBStartAddress: 0.., set at pre-compile in variant pre-compile / link in variant link-time+post-build, origin=Vector Informatik, default-value=0  # This parameter configures the start address of the ROM memory block where the post build configuration data will be located. It is relevant and visible only in a post build configuration IPduM_ConfigurationVariant == Variant 3 (Postbuild Configuration).
      integer IPduMBufferSize: 0.., set at link, origin=Vector Informatik, default-value=0  # This parameter displays the computed RAM buffer size required by the transmission multiplex I-PDU(s) in the IpduM configuration. The value may be incremented at link time to reserve buffer if, transmission multiplex I-PDU(s) will be added in a post build configuration.
      integer IPduMMaxRxBufferSize: 0.., set at link, origin=Vector Informatik, default-value=0  # This parameter displays the computed RAM buffer size required by the reception multiplex I-PDU(s) in the IpduM configuration. The value may be incremented at link time if the length of the largest reception multiplex I-PDU(s) may vary / be incremented in a post build configuration.
      integer IPduMMaxNumberOfTxRequests: 0.., set at link, origin=Vector Informatik, default-value=0  # This parameter displays the count of transmission multiplex I-PDU(s) (IPduMTxRequest) in the IpduM configuration. The value may be incremented at link time if transmission multiplex I-PDU(s) / TxRequests will be added in a post build configuration.
      boolean IPduMUsePduInfoType [0..1]: set at pre-compile, origin=Vector Informatik, default-value=false  # If this feature is activated, PduInfoPtr instead of SduPtr is used for the APIs IpduM_RxIndication and IpduM_TriggerTransmit.
      boolean IPduMDynamicDlcSupport [0..1]: set at pre-compile, origin=Vector Informatik, default-value=false  # If this feature is activated, the received data length (PduInfoPtr->SduLength) is checked by the function IpduM_RxIndication and only completely received static or dynamic parts are processed.
    container IPduMConfig [1..*]: multiple-configuration-container=true  # This container is a MultipleConfigurationContainer, i.e. this container and its sub-containers exist once per configuration set. This container contains the sub containers of the IPduMplex module. The IPduMTxPathway container includes information about the transmission multiplex I-PDUs. The IPduMRxPathway container includes information about the reception multiplex I-PDUs.
      container IPduMRxPathway [0..*]  # Contains the configuration parameters of the multiplex I-PDU(s) received by the IPduM module.
        container IPduMRxIndication  # Contains the configuration for incoming RxIndication calls.
          integer IPduMRxHandleId: set at pre-compile in variant pre-compile / link in variant link-time / post-build in variant post-build  # This Parameter value as displayed may not used by IPDU Multiplexer. This is the I-PDU ID of the incoming multiplexed I-PDU. If an incoming RxIndication's I-PDU ID matches this value then it is de-multiplexed according to the corresponding static (if exists) and dynamic part(s) bit field specifications (see IPduMCopyBitFields for each part).
          reference IPduMRxIndicationPduRef: set at pre-compile in variant pre-compile / link in variant link-time / post-build in variant post-build, destination=Pdu  # Reference to the received Pdu representation in the ECU Configuration Description exchange file.
          container IPduMBitField  # This is used to specify a contiguous range of bits within an I-PDU. The range is inclusive.
            integer IPduMEndBit: 0..63, set at pre-compile in variant pre-compile / link in variant link-time / post-build in variant post-build  # Selector field end bit position in the multiplex I-PDU. Value must fit inside the I-PDU. Value must be the same as or higher than IPduMStartBit.
            integer IPduMStartBit: 0..63, set at pre-compile in variant pre-compile / link in variant link-time / post-build in variant post-build  # Selector field start bit position in the multiplex I-PDU. Value must fit inside the I-PDU. Value must be the same as or lower than IPduMEndBit.
          container IPduMRxDynamicPart [1..*]  # This container contains the configuration for the dynamic parts of the incoming RxIndication calls. When an incoming reception multiplex I-PDU's selector field matches the IPduMRxSelectorValue of any of the dynamic parts, the I-PDU is de-multiplexed according to the corresponding IPduMCopyBitfield specification and sent out with the I-PDU ID referenced by IPduMOutgoingDyamicPduRef.
            integer IPduMRxSelectorValue: 0..255, set at pre-compile in variant pre-compile / link in variant link-time / post-build in variant post-build  # If the selector field value of the received multiplex I-PDU matches this value. It will be de-multiplexed according to the configuration for the corresponding dynamic part.
            reference IPduMOutgoingDynamicPduRef: set at pre-compile in variant pre-compile / link in variant link-time / post-build in variant post-build, destination=Pdu  # Reference to the de-multiplexed Pdu' (dynamic part) representation in the ECU Configuration description exchange file.
            container IPduMCopyBitField [1..*]  # Specifies the source bit fields and the destination bit positions, so that the bits in the source can be copied to their destination. Within one I-PDU multiple instances of this container may be used to specify the bit fields in that I-PDU. Adjacent bit fields could be merged in order to reduce the number of instances of this container.
              integer IPduMDestinationBit: 0..63, set at pre-compile in variant pre-compile / link in variant link-time / post-build in variant post-build  # Destination bit field start position in an I-PDU for copying. The resulting destination bit field must fit inside the I-PDU.
              container IPduMBitField  # This is used to specify a contiguous range of bits within an I-PDU. The range is inclusive.
                integer IPduMEndBit: 0..63, set at pre-compile in variant pre-compile / link in variant link-time / post-build in variant post-build  # Source bit field end position in an I-PDU. Value must fit inside the I-PDU. Value must be the same as or higher than IPduMStartBit.
                integer IPduMStartBit: 0..63, set at pre-compile in variant pre-compile / link in variant link-time / post-build in variant post-build  # Source bit field start position in an I-PDU. Value must fit inside the I-PDU. Value must be the same as or lower than IPduMEndBit.
          container IPduMRxStaticPart [0..1]  # This container contains the configuration for the static part (if exists) of the incoming RxIndication calls. The I-PDU is de-multiplexed according to the corresponding static IPduMCopyBitfield specifications and sent out with the I-PDU ID referenced by IPduMOutgoingStaticPduRef.
            reference IPduMOutgoingStaticPduRef: set at pre-compile in variant pre-compile / link in variant link-time / post-build in variant post-build, destination=Pdu  # Reference to the de-multiplexed Pdu' (static part if it exists) representation in the ECU Configuration Description exchange file.
            container IPduMCopyBitField [1..*]  # Specifies the source bit fields and the destination bit positions, so that the bits in the source can be copied to their destination. Within one I-PDU multiple instances of this container may be used to specify the bit fields in that I-PDU. Adjacent bit fields could be merged in order to reduce the number of instances of this container.
              integer IPduMDestinationBit: 0..63, set at pre-compile in variant pre-compile / link in variant link-time / post-build in variant post-build  # Destination bit field start position in an I-PDU for copying. The resulting destination bit field must fit inside the I-PDU.
              container IPduMBitField  # This is used to specify a contiguous range of bits within an I-PDU. The range is inclusive.
                integer IPduMEndBit: 0..63, set at pre-compile in variant pre-compile / link in variant link-time / post-build in variant post-build  # Source bit field end position in an I-PDU. Value must fit inside the I-PDU. Value must be the same as or higher than IPduMStartBit.
                integer IPduMStartBit: 0..63, set at pre-compile in variant pre-compile / link in variant link-time / post-build in variant post-build  # Source bit field start position in an I-PDU. Value must fit inside the I-PDU. Value must be the same as or lower than IPduMEndBit.
      container IPduMTxPathway [0..*]  # Contains the configuration parameters of the multiplex I-PDU(s) transmitted by the IPduM module.
        container IPduMTxConfirmation [0..1]  # A transmit request can be confirmed by the lower layer. This container is used to generate the matching confirmations for the static and dynamic parts of a multiplexed I-PDU. When an I-PDU is transmitted by the IPduM, the selector field value in that PDU needs to be stored in the IPduM so that the confirmation for the correct dynamic part can be generated. This is state internal to the IPduM at run-time. For the purposes of this container and IPduMDynamicTxConfirmation this stored state is called Stored_Selector.
          reference IPduMStaticTxConfirmationIPduRef [0..1]: set at pre-compile in variant pre-compile / link in variant link-time / post-build in variant post-build, destination=Pdu  # This references the I-PDU to use in the TxConfirmation for the static part. This entity does not appear if there is no static part exists for the respective multiplex I-PDU.
          container IPduMDynamicTxConfirmation [1..*]  # The dynamic part of an I-PDU can have more than one I-PDU IDs for confirmations. The correct I-PDU ID for the confirmation is found from the previously transmitted I-PDU.
            integer IPduMSelectorValue: 0..255, set at pre-compile in variant pre-compile / link in variant link-time / post-build in variant post-build  # NOTE: This Parameter value is not required / used by IPDU Multiplexer. When the selector field of the confirmed I-PDU matches the value in here then generate a TxConfirmation for the I-PDU referenced by IPduMDynamicTxConfirmIPduRef.
            reference IPduMDynamicTxConfirmIPduRef: set at pre-compile in variant pre-compile / link in variant link-time / post-build in variant post-build, destination=Pdu  # This references the multiplexed dynamic part whose transmission should be confirmed when, the transmission of an IPduM multiplex I-PDU is confirmed and its IPduMSelectorValue matches the stored selector field value (Stored_Selector).
        container IPduMTxRequest  # Contains the configuration of transmit requests. There will one instance of this container for each multiplex I-PDU that can be requested for transmission (the outgoing I-PDUs).
          integer IPduMIPduUnusedAreasDefault [0..1]: 0..255, set at pre-compile in variant pre-compile / link in variant link-time / post-build in variant post-build  # The bit-pattern of the value configured to this parameter is used to fill unused areas in a transmission multiplex I-PDU. If this parameter is omitted the unused areas in the transmission multiplex I-PDU are not filled.
          integer IPduMInitialSelectorValue: 0..255, set at pre-compile in variant pre-compile / link in variant link-time / post-build in variant post-build  # The value configured to this parameter is used to determine the initial value for the corresponding transmission multipex I-PDU from its associated dynamic part(s).
          integer IPduMSize: 0..254, set at pre-compile in variant pre-compile / link in variant link-time / post-build in variant post-build  # The size of the multiplex I-PDU in bytes. The maximum size is limited by the underlying communication interface. 0-8 for CAN and LIN 0-254 for FlexRay.
          float IPduMTxConfirmationTimeout [0..1]: set at pre-compile in variant pre-compile / link in variant link-time / post-build in variant post-build  # The value configured to this parameter is a timeout period (in seconds) for monitoring the confirmation of the transmission of the corresponding multiplex I-PDU. It is not used when an I-PDU is requested using the trigger transmit API.
          enumeration IPduMTxTriggerMode: {DYNAMIC_PART_TRIGGER, NONE, STATIC_OR_DYNAMIC_PART_TRIGGER, STATIC_PART_TRIGGER}, set at pre-compile in variant pre-compile / link in variant link-time / post-build in variant post-build, default-value=DYNAMIC_PART_TRIGGER  # This parameter configures the event on which the transmission of the multiplex I-PDU is triggered.
          reference IPduMOutgoingPduRef: set at pre-compile in variant pre-compile / link in variant link-time / post-build in variant post-build, destination=Pdu  # Reference to the I-PDU representation in the ECU Configuration Description exchange file defining the multiplex I-PDU transmitted by the I-PDU multiplexer. When the outgoing I-PDU is sent it uses the corresponding I-PDU ID.
          container IPduMBitField  # This is used to specify a contiguous range of bits within an I-PDU. The range is inclusive.
            integer IPduMEndBit: 0..63, set at pre-compile in variant pre-compile / link in variant link-time / post-build in variant post-build  # Selector field end bit position in the multiplex I-PDU. Value must fit inside the I-PDU. Value must be the same as or higher than IPduMStartBit.
            integer IPduMStartBit: 0..63, set at pre-compile in variant pre-compile / link in variant link-time / post-build in variant post-build  # Selector field start bit position in the multiplex I-PDU. Value must fit inside the I-PDU. Value must be the same as or lower than IPduMEndBit.
          container IPduMTxDynamicPart [1..*]  # Configuration parameters for an instance of a TxRequest call into the IPduM. When a Tx Request with the IPduMTxDynamicHandleId is received by the IPduM, the bit fields in the incoming I-PDU are packed into the outgoing I-PDU buffer and the send mode honored. This container is used by the dynamic part of a TxRequest configuration. Therefore, for each outgoing I-PDU there will be atleast one instance of this container for the dynamic part.
            integer IPduMTxDynamicHandleId: set at pre-compile in variant pre-compile / link in variant link-time / post-build in variant post-build  # This Parameter value as displayed may not used by the I-PDU Multiplexer. When the handle of an incoming Tx Request matches this value, the bits fields (see corresponding IPduMCopyBitField) are copied and the trigger mode (see IPduMTxTriggerMode) of the corresponding transmission multiplex I-PDU is honored.
            reference IPduMTxDynamicPduRef: set at pre-compile in variant pre-compile / link in variant link-time / post-build in variant post-build, destination=Pdu  # Reference to the multiplexed Pdu' (dynamic part) representation in the ECU Configuration Description exchange file.
            container IPduMCopyBitField [1..*]  # Specifies the source bit fields and the destination bit positions, so that the bits in the source can be copied to their destination. Within one I-PDU multiple instances of this container may be used to specify the bit fields in that I-PDU. Adjacent bit fields could be merged in order to reduce the number of instances of this container.
              integer IPduMDestinationBit: 0..63, set at pre-compile in variant pre-compile / link in variant link-time / post-build in variant post-build  # Destination bit field start position in an I-PDU for copying. The resulting destination bit field must fit inside the I-PDU.
              container IPduMBitField  # This is used to specify a contiguous range of bits within an I-PDU. The range is inclusive.
                integer IPduMEndBit: 0..63, set at pre-compile in variant pre-compile / link in variant link-time / post-build in variant post-build  # Source bit field end position in an I-PDU. Value must fit inside the I-PDU. Value must be the same as or higher than IPduMStartBit.
                integer IPduMStartBit: 0..63, set at pre-compile in variant pre-compile / link in variant link-time / post-build in variant post-build  # Source bit field start position in an I-PDU. Value must fit inside the I-PDU. Value must be the same as or lower than IPduMEndBit.
          container IPduMTxStaticPart [0..1]  # Configuration parameters for an instance of a TxRequest call into the IPduM. When a Tx Request with the IPduMTxStaticHandleId is received by the IPduM, the bit fields in the incoming I-PDU are packed into the outgoing I-PDU buffer and the send mode honored. This container is used by the static part of a TxRequest configuration. Therefore, for each outgoing I-PDU there will be one instance of this container for the static part if it exists.
            integer IPduMTxStaticHandleId: set at pre-compile in variant pre-compile / link in variant link-time / post-build in variant post-build  # This Parameter value as displayed may not used by IPDU Multiplexer. When the handle of an incoming Tx Request matches this value, the bits fields (see corresponding IPduMCopyBitField) are copied and the trigger mode (see IPduMTxTriggerMode) of the corresponding multiplex I-PDU is honored.
            reference IPduMTxStaticPduRef: set at pre-compile in variant pre-compile / link in variant link-time / post-build in variant post-build, destination=Pdu  # Reference to the multiplexed Pdu' (static part, if it exists) representation in the ECU Configuration Description exchange file.
            container IPduMCopyBitField [1..*]  # Specifies the source bit fields and the destination bit positions, so that the bits in the source can be copied to their destination. Within one I-PDU multiple instances of this container may be used to specify the bit fields in that I-PDU. Adjacent bit fields could be merged in order to reduce the number of instances of this container.
              integer IPduMDestinationBit: 0..63, set at pre-compile in variant pre-compile / link in variant link-time / post-build in variant post-build  # Destination bit field start position in an I-PDU for copying. The resulting destination bit field must fit inside the I-PDU.
              container IPduMBitField  # This is used to specify a contiguous range of bits within an I-PDU. The range is inclusive.
                integer IPduMEndBit: 0..63, set at pre-compile in variant pre-compile / link in variant link-time / post-build in variant post-build  # Source bit field end position in an I-PDU. Value must fit inside the I-PDU. Value must be the same as or higher than IPduMStartBit.
                integer IPduMStartBit: 0..63, set at pre-compile in variant pre-compile / link in variant link-time / post-build in variant post-build  # Source bit field start position in an I-PDU. Value must fit inside the I-PDU. Value must be the same as or lower than IPduMEndBit.
    container IPduMplexCh [0..1]
      reference ComMChannelRef [0..1]: set at pre-compile in variant pre-compile+post-build / link in variant link-time, destination=ComMChannel  # This is needed for GENy module activation
    container VectorCommonData
      string BswmdVersion: set at published-information, origin=Vector Informatik, default-value=1.04.02  # Version of the BSWMD file that has been used to set up the ECU configuration
  module config IPduMplex_Pre: definition=IPduMplex
  module config IPduMplex_Rec: definition=IPduMplex
