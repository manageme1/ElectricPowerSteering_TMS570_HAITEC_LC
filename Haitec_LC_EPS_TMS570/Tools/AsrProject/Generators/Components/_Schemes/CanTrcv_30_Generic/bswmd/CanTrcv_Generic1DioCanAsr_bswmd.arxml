AUTOSAR XML (schema 3.0.1)
# COPYRIGHT
# Copyright (c) 2011 by Vector Informatik GmbH. All rights reserved.
# This software is copyright protected and proprietary to Vector Informatik GmbH.
# Vector Informatik GmbH grants to you only those rights as set out in the license conditions.
package /MICROSAR/CanTrcv_Generic1CanDio
  bsw implementation CanTrcv_Impl: code-generator=cMICROSAR,GENy, programming-language=C, sw-major-version=1, sw-minor-version=14, sw-patch-version=1, vendor-id=30, ar-major-version=1, ar-minor-version=2, ar-patch-version=0, preconfigured-configuration=CanTrcv_Pre, recommended-configuration=CanTrcv_Rec, vendor-api-infix=__Your_Trcv__, vendor-specific-module-def=CanTrcv
  module definition CanTrcv: refined-module-def=CanTrcv, variants pre-compile  # Configuration of the CanTrcv (CAN Transceiver driver) module.
    container CanTrcvChannel [1..*]  # Container gives CAN transceiver driver information about a single CAN transceiver channel. Any CAN transceiver driver has such CAN transceiver channels.
      integer CanTrcvChannelId: set at pre-compile, symbolic-name-value=true  # Not Used. Unique identifier of the CAN Transceiver Channel.
      boolean CanTrcvChannelUsed: set at pre-compile, default-value=true  # Shall the related CAN transceiver channel be used?
      boolean CanTrcvControlsPowerSupply: set at pre-compile, default-value=false  # Is ECU power supply controlled by this transceiver? TRUE = Controlled by transceiver. FALSE = Not controlled by transceiver.
      enumeration CanTrcvInitState: {CANTRCV_OP_MODE_NORMAL, CANTRCV_OP_MODE_SLEEP, CANTRCV_OP_MODE_STANDBY}, set at pre-compile, default-value=CANTRCV_OP_MODE_NORMAL  # State of CAN transceiver after call to CanTrcv_Init.
      integer CanTrcvMaxBaudrate: 0..1000, set at pre-compile, default-value=1000  # Not Used. Max baudrate for transceiver hardware type. Only used for validation purposes. Value shall be configured by configuration tool based on transceiver hardware type.
      boolean CanTrcvWakeupByBusUsed: set at pre-compile, default-value=false  # Is wake up by bus supported? If CAN transceiver hardware does not support wake up by bus value is always FALSE. If CAN transceiver hardware supports wake up by bus value is TRUE or FALSE depending whether it is used or not. TRUE = Is used. FALSE = Is not used.
      integer CanTrcv_WakeupSourceId [0..1]: 0..255, set at pre-compile, origin=Vector Informatik, default-value=0  # If no CanTrcvWakeupSourceRef can be found, this integer serves as backup solution to store the wakeup source.
      symbolic name reference CanTrcvWakeupSourceRef: set at pre-compile, destination=EcuMWakeupSource  # Reference to a wakeup source in the EcuM configuration. This reference is only needed if CanTrcvWakeupByBusUsed is true. Implementation Type: reference to EcuM_WakeupSourceType
      choice container CanTrcvAccess [1..*]
        container CanTrcvDioAccess [0..1]  # Container gives CAN transceiver driver information about accessing ports and port pins. In addition relation between CAN transceiver hardware pin names and Dio port access information is given. If a CAN transceiver hardware has no Dio interface, there is no instance of this container.
          string CanTrcvHardwareInterfaceName: set at pre-compile  # CAN transceiver hardware interface name. It is typically the name of a pin. From a Dio point of view it is either a port, a single channel or a channel group. Depending on this fact either CANTRCV_DIO_PORT_SYMBOLIC_NAME or CANTRCV_DIO_CHANNEL_SYMBOLIC_NAME or CANTRCV_DIO_CHANNEL_GROUP_SYMBOLIC_NAME shall reference a Dio configuration. The CAN transceiver driver implementation description shall list up this name for the appropriate CAN transceiver hardware.
          choice reference CanTrcvDioSymNameRef: set at pre-compile, destination=[DioChannelGroup, DioPort, DioChannel]  # Choice Reference to a DIO Port, DIO Channel or DIO Channel Group. This reference replaces the CANTRCV_DIO_PORT_SYM_NAME, CANTRCV_DIO_CHANNEL_SYM_NAME and CANTRCV_DIO_GROUP_SYM_NAME references in the Can Trcv SWS.
        container CanTrcvSpiSequence [0..1]  # Container gives CAN transceiver driver information about one SPI sequence. One SPI sequence used by CAN transceiver driver is in exclusive use for it. No other driver is allowed to access this sequence. CAN transceiver driver may use one sequence to access n CAN transceiver hardwares chips of the same type or n sequences are used to access one single CAN transceiver hardware chip. If a CAN transceiver hardware has no SPI interface, there is no instance of this container.
          symbolic name reference CanTrcvSpiSequenceName: set at pre-compile, destination=SpiSequence  # Reference to a Spi sequence configuration container.
    container CanTrcvGeneral  # Container gives CAN transceiver driver basic information.
      boolean CanTrcvDevErrorDetect: set at pre-compile, default-value=true  # Switches development error detection and notification on and off. If switched on, #define CANTRCV_DEV _ERROR_DETECT ON shall be generated. If switched off, #define CANTRCV_DEV_ERROR _DETECT OFF shall be generated. Define shall be part of file CanTrcv_Cfg.h.
      boolean CanTrcvGetVersionInfo: set at pre-compile, default-value=false  # Switches version information API on and off. If switched off, function need not be present in compiled code.
      integer CanTrcvIndex: 0..8, set at pre-compile, default-value=0  # Specifies the InstanceId of this module instance. If only one instance is present it shall have the Id 0.
      enumeration CanTrcvWakeUpSupport: {CANTRCV_WAKEUP_BY_ISR, CANTRCV_WAKEUP_NOT_SUPPORTED, CANTRCV_WAKEUP_BY_POLLING}, set at pre-compile, default-value=CANTRCV_WAKEUP_NOT_SUPPORTED  # Informs whether wake up is supported by ISR, by polling or whether it is not supported. In case no wake up is supported by CAN transceiver hardware setting has to be always NO. Only in case wake up is supported by polling main function CanTrcv_main has to be present in source code and called by CanIf. Only in case wake up is supported by ISR callback function CanTrcv_CB_WakeupByBus has to be present in source code. In case of support for wake up either by ISR or by polling wake up ability may be switched on or off for each channel of one CAN transceiver channel independently by CanTrcvWakeupByBusUsed.
      string CanTrcvComponentName: set at pre-compile, origin=Vector Informatik, default-value=GenericX
      string CanTrcvDioPin [0..*]: set at pre-compile, origin=Vector Informatik, default-value=CanTrcvpin
      string CanTrcvUserConfigFile [0..1]: set at pre-compile, origin=Vector Informatik  # If a file path will be specified, the file is read and its contents is put at the end of this modules config file.
      boolean CanTrcvDevProdDetect [0..1]: set at pre-compile, origin=Vector Informatik, default-value=true  # If Production Error Detection is enabled, production relevant errors are reported to the Diagnostics Event Manager (DEM). Disable this option, if no DEM is present in your system
      string CanTrcvDEMEvent [0..*]: set at pre-compile, origin=Vector Informatik  # This container is used only by GENy to store user-defined DEM Events created for this Transceiver.
    container VectorCommonData  # Container gives provides support for CAN transceiver version conflict recognition.
      string BswmdVersion: configuration-class-affection=affection-kind=NO-AFFECT, set at published-information, origin=Vector Informatik, default-value=1.04.02
  module config CanTrcv_Pre: definition=CanTrcv
  module config CanTrcv_Rec: definition=CanTrcv
