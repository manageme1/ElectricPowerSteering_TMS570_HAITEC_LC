AUTOSAR XML (schema 3.0.2)
package /InitialEcuC
  ecu configuration InitialEcuC: ecu-extract=System, module=[Can, CanIf, CanSM, CanTp, Com, PduR, EcuC, ComM]
  module config Can
    CanGeneral: CanIndex=0
    CanConfigSet
      CAN00 (CanController): CanControllerActivation=true
  module config CanIf
    CanIfPublicConfiguration
    CanIfPrivateConfiguration
    CanIfInitConfiguration: CanIfConfigSet=initConfiguration
      CanIfInitHohConfig: CanIfRefConfigSet=CanConfigSet
      CT_CAN00 (CanIfInitControllerConfig)
      4 x CanIfRxPduConfig, all with CanIfCanRxPduDlc=8, CanIfRxPduIdCanIdType=STANDARD_CAN:
        ABS2__CAN00: CanIfCanRxPduCanId=864, PduIdRef=PduCollection/ABS2__CAN00
        BCM1__CAN00: CanIfCanRxPduCanId=1056, PduIdRef=PduCollection/BCM1__CAN00
        DiagFuncReqFT_Tp__CAN00: CanIfCanRxPduCanId=2000, PduIdRef=PduCollection/DiagFuncReqFT_Tp__CAN00
        DiagPhysReqToEPAS_Tp__CAN00: CanIfCanRxPduCanId=1906, PduIdRef=PduCollection/DiagPhysReqToEPAS_Tp__CAN00
      DiagRespFromEPAS_Tp__CAN00 (CanIfTxPduConfig):
        CanIfCanTxPduIdCanId = 1970
        CanIfCanTxPduIdDlc = 8
        CanIfCanTxPduType = STATIC
        CanIfTxPduIdCanIdType = STANDARD_CAN
        PduIdRef = PduCollection/DiagRespFromEPAS_Tp__CAN00
      ECM1__CAN00 (CanIfRxPduConfig): CanIfCanRxPduCanId=790, CanIfCanRxPduDlc=8, CanIfRxPduIdCanIdType=STANDARD_CAN, PduIdRef=PduCollection/ECM1__CAN00
      EPAS1__CAN00 (CanIfTxPduConfig): CanIfCanTxPduIdCanId=922, CanIfCanTxPduIdDlc=8, CanIfCanTxPduType=STATIC, CanIfTxPduIdCanIdType=STANDARD_CAN, PduIdRef=PduCollection/EPAS1__CAN00
      EPAS2__CAN00 (CanIfTxPduConfig): CanIfCanTxPduIdCanId=926, CanIfCanTxPduIdDlc=8, CanIfCanTxPduType=STATIC, CanIfTxPduIdCanIdType=STANDARD_CAN, PduIdRef=PduCollection/EPAS2__CAN00
      GliwaMaster__CAN00 (CanIfRxPduConfig): CanIfCanRxPduCanId=2032, CanIfCanRxPduDlc=8, CanIfRxPduIdCanIdType=STANDARD_CAN, PduIdRef=PduCollection/GliwaMaster__CAN00
      GliwaSlave__CAN00 (CanIfTxPduConfig):
        CanIfCanTxPduIdCanId = 2033
        CanIfCanTxPduIdDlc = 8
        CanIfCanTxPduType = STATIC
        CanIfTxPduIdCanIdType = STANDARD_CAN
        PduIdRef = PduCollection/GliwaSlave__CAN00
      NMmBCM__CAN00 (CanIfRxPduConfig): CanIfCanRxPduCanId=1792, CanIfCanRxPduDlc=8, CanIfRxPduIdCanIdType=STANDARD_CAN, PduIdRef=PduCollection/NMmBCM__CAN00
      NMmEPAS__CAN00 (CanIfTxPduConfig): CanIfCanTxPduIdCanId=1799, CanIfCanTxPduIdDlc=8, CanIfCanTxPduType=STATIC, CanIfTxPduIdCanIdType=STANDARD_CAN, PduIdRef=PduCollection/NMmEPAS__CAN00
      XcpMaster__CAN00 (CanIfRxPduConfig): CanIfCanRxPduCanId=1685, CanIfCanRxPduDlc=8, CanIfRxPduIdCanIdType=STANDARD_CAN, PduIdRef=PduCollection/XcpMaster__CAN00
      XcpSlave__CAN00 (CanIfTxPduConfig):
        CanIfCanTxPduIdCanId = 1765
        CanIfCanTxPduIdDlc = 8
        CanIfCanTxPduType = STATIC
        CanIfTxPduIdCanIdType = STANDARD_CAN
        PduIdRef = PduCollection/XcpSlave__CAN00
    CanIfDriverConfig: CanIfDriverNameRef=CanGeneral, CanIfInitHohConfigRef=CanIfInitHohConfig
    CT_CAN00 (CanIfControllerConfig): CanIfDriverNameRef=CanIfDriverConfig
  module config CanSM
    CanStateManagerConfiguration
      CAN00 (CanStateManagerNetworks): CanSMNetworkHandle=ComM/CAN00
        CT_CAN00 (CanStateManagerControllers): CanSMControllerId=CanConfigSet/CAN00
  module config CanTp
    CanTpGeneral: CanTpSupportMixed11Addressing=false
    DiagFuncReqFT__CAN00 (CanTpRxNSdu):
      CanTpAddressingFormat = CANTP_STANDARD
      CanTpRxPaddingActivation = CANTP_ON
      CanTpRxTaType = CANTP_FUNCTIONAL
      CanTpRxNSduRef = PduCollection/DiagFuncReqFT__CAN00
      DiagFuncReqFT_Tp__CAN00 (CanTpRxNPdu): CanTpRxNPduRef=PduCollection/DiagFuncReqFT_Tp__CAN00
    DiagRespFromEPAS__CAN00 (CanTpTxNSdu):
      CanTpAddressingMode = CANTP_STANDARD
      CanTpTxPaddingActivation = CANTP_ON
      CanTpTxTaType = CANTP_PHYSICAL
      CanTpTxNSduRef = PduCollection/DiagRespFromEPAS__CAN00
      DiagRespFromEPAS_Tp__CAN00_0 (CanTpTxNPdu): CanTpTxNPduRef=PduCollection/DiagRespFromEPAS_Tp__CAN00
      DiagPhysReqToEPAS_Tp__CAN00 (CanTpRxFcNPdu): CanTpRxFcNPduRef=PduCollection/DiagPhysReqToEPAS_Tp__CAN00
    DiagPhysReqToEPAS__CAN00_EPAS (CanTpRxNSdu): CanTpAddressingFormat=CANTP_STANDARD, CanTpRxPaddingActivation=CANTP_ON, CanTpRxTaType=CANTP_PHYSICAL, CanTpRxNSduRef=DiagPhysReqToEPAS__CAN00
      DiagPhysReqToEPAS_Tp__CAN00_2 (CanTpRxNPdu): CanTpRxNPduRef=PduCollection/DiagPhysReqToEPAS_Tp__CAN00
      DiagPhysReqToEPAS_Tp__CAN00_1 (CanTpTxFcNPdu): CanTpTxFcNPduRef=PduCollection/DiagRespFromEPAS_Tp__CAN00
  module config Com
    ComGeneral: ComConfigurationTimeBase=0.001
    ComConfig
      PduGrp_EPAS__CAN00_Rx (ComIPduGroup)
      PduGrp_EPAS__CAN00_Tx (ComIPduGroup)
      5 x ComIPdu, all with ComIPduSize=8:
        Pdu_ABS2__CAN00: ComIpduDirection=RECEIVE, ComIPduGroupRef=PduGrp_EPAS__CAN00_Rx, ComIPduSignalRef=Com_VehSpeed__ABS2__CAN00, PduIdRef=PduCollection/ABS2__CAN00
        Pdu_BCM1__CAN00: ComIpduDirection=RECEIVE, ComIPduGroupRef=PduGrp_EPAS__CAN00_Rx, ComIPduSignalRef=Com_BCM_Key_Sta__BCM1__CAN00, PduIdRef=PduCollection/BCM1__CAN00
        Pdu_ECM1__CAN00: ComIpduDirection=RECEIVE, ComIPduGroupRef=PduGrp_EPAS__CAN00_Rx, ComIPduSignalRef=Com_LV_CAN_N_ERR__ECM1__CAN00, ComIPduSignalRef=Com_CAN_N__ECM1__CAN00, PduIdRef=PduCollection/ECM1__CAN00
        Pdu_EPAS1__CAN00: ComIpduDirection=SEND, ComIPduGroupRef=PduGrp_EPAS__CAN00_Tx, ComIPduSignalRef=Com_SAS_Angle__EPAS1__CAN00, ComIPduSignalRef=Com_SAS_OK__EPAS1__CAN00, ComIPduSignalRef=Com_SAS_CAL__EPAS1__CAN00, ComIPduSignalRef=Com_SAS_CheckSum__EPAS1__CAN00, ComIPduSignalRef=Com_SAS_MsgCount__EPAS1__CAN00, ComIPduSignalRef=Com_SAS_Init__EPAS1__CAN00, PduIdRef=PduCollection/EPAS1__CAN00
          ComTxIPdu: ComTxIPduMinimumDelayTimeFactor=0
            ComTxModeFalse
              ComTxModeFalseFalse (ComTxMode): ComTxModeMode=PERIODIC, ComTxModeTimeOffsetFactor=0, ComTxModeTimePeriodFactor=10
            ComTxModeTrue
              ComTxModeTrueTrue (ComTxMode): ComTxModeMode=PERIODIC, ComTxModeTimeOffsetFactor=0, ComTxModeTimePeriodFactor=10
        Pdu_EPAS2__CAN00: ComIpduDirection=SEND, ComIPduGroupRef=PduGrp_EPAS__CAN00_Tx, ComIPduSignalRef=Com_Elect_PWR_Consumpt__EPAS2__CAN00, ComIPduSignalRef=Com_Steering_Torque_V__EPAS2__CAN00, ComIPduSignalRef=Com_Rel_Steer_Wheel_Ang_Validity__EPAS2__CAN00, ComIPduSignalRef=Com_EpasFailed__EPAS2__CAN00, ComIPduSignalRef=Com_Steering_Torque__EPAS2__CAN00, ComIPduSignalRef=Com_Rel_Steer_Wheel_Ang__EPAS2__CAN00, PduIdRef=PduCollection/EPAS2__CAN00
          ComTxIPdu: ComTxIPduMinimumDelayTimeFactor=0
            ComTxModeFalse
              ComTxModeFalseFalse (ComTxMode): ComTxModeMode=PERIODIC, ComTxModeTimeOffsetFactor=0, ComTxModeTimePeriodFactor=10
            ComTxModeTrue
              ComTxModeTrueTrue (ComTxMode): ComTxModeMode=PERIODIC, ComTxModeTimeOffsetFactor=0, ComTxModeTimePeriodFactor=10
      16 x ComSignal, all with ComSignalEndianess=BIG_ENDIAN, ComTransferProperty=PENDING:
        Com_VehSpeed__ABS2__CAN00: ComBitPosition=7, ComBitSize=12, ComSignalInitValue=0, SystemTemplateSystemSignalRef=VehSpeed
        Com_BCM_Key_Sta__BCM1__CAN00: ComBitPosition=7, ComBitSize=2, ComSignalInitValue=0, SystemTemplateSystemSignalRef=BCM_Key_Sta
        Com_LV_CAN_N_ERR__ECM1__CAN00: ComBitPosition=1, ComBitSize=1, ComSignalInitValue=0, SystemTemplateSystemSignalRef=LV_CAN_N_ERR
        Com_CAN_N__ECM1__CAN00: ComBitPosition=23, ComBitSize=16, ComSignalInitValue=0, SystemTemplateSystemSignalRef=CAN_N
        Com_SAS_Angle__EPAS1__CAN00: ComBitPosition=7, ComBitSize=16, ComSignalInitValue=9001, SystemTemplateSystemSignalRef=SAS_Angle
        Com_SAS_OK__EPAS1__CAN00: ComBitPosition=24, ComBitSize=1, ComSignalInitValue=1, SystemTemplateSystemSignalRef=SAS_OK
        Com_SAS_CAL__EPAS1__CAN00: ComBitPosition=25, ComBitSize=1, ComSignalInitValue=0, SystemTemplateSystemSignalRef=SAS_CAL
        Com_SAS_CheckSum__EPAS1__CAN00: ComBitPosition=35, ComBitSize=4, ComSignalInitValue=0, SystemTemplateSystemSignalRef=SAS_CheckSum
        Com_SAS_MsgCount__EPAS1__CAN00: ComBitPosition=39, ComBitSize=4, ComSignalInitValue=0, SystemTemplateSystemSignalRef=SAS_MsgCount
        Com_SAS_Init__EPAS1__CAN00: ComBitPosition=47, ComBitSize=1, ComSignalInitValue=0, SystemTemplateSystemSignalRef=SAS_Init
        Com_Elect_PWR_Consumpt__EPAS2__CAN00: ComBitPosition=7, ComBitSize=8, ComSignalInitValue=0, SystemTemplateSystemSignalRef=Elect_PWR_Consumpt
        Com_Steering_Torque_V__EPAS2__CAN00: ComBitPosition=8, ComBitSize=1, ComSignalInitValue=0, SystemTemplateSystemSignalRef=Steering_Torque_V
        Com_Rel_Steer_Wheel_Ang_Validity__EPAS2__CAN00: ComBitPosition=14, ComBitSize=1, ComSignalInitValue=0, SystemTemplateSystemSignalRef=Rel_Steer_Wheel_Ang_Validity
        Com_EpasFailed__EPAS2__CAN00: ComBitPosition=15, ComBitSize=1, ComSignalInitValue=0, SystemTemplateSystemSignalRef=EpasFailed
        Com_Steering_Torque__EPAS2__CAN00: ComBitPosition=23, ComBitSize=8, ComSignalInitValue=128, SystemTemplateSystemSignalRef=Steering_Torque
        Com_Rel_Steer_Wheel_Ang__EPAS2__CAN00: ComBitPosition=47, ComBitSize=16, ComSignalInitValue=20000, SystemTemplateSystemSignalRef=Rel_Steer_Wheel_Ang
  module config PduR
    PduRGeneral
    PduRGlobalConfig
      PduRRoutingTable
  module config EcuC
    PduCollection
      17 x Pdu:
        ABS2__CAN00: PduLength=64
        BCM1__CAN00: PduLength=64
        DiagFuncReqFT_Tp__CAN00
        DiagPhysReqToEPAS_Tp__CAN00
        DiagRespFromEPAS_Tp__CAN00
        ECM1__CAN00: PduLength=64
        EPAS1__CAN00: PduLength=64
        EPAS2__CAN00: PduLength=64
        GliwaMaster__CAN00: PduLength=64
        GliwaSlave__CAN00: PduLength=64
        NMmBCM__CAN00: PduLength=64
        NMmEPAS__CAN00: PduLength=64
        XcpMaster__CAN00: PduLength=64
        XcpSlave__CAN00: PduLength=64
        DiagFuncReqFT__CAN00: PduLength=64
        DiagPhysReqToEPAS__CAN00: PduLength=64
        DiagRespFromEPAS__CAN00: PduLength=64
  module config ComM
    ComMConfig
      CAN00 (ComMNetworks): ComMNetworkHandle=ComM/CAN00
    CAN00 (ComMChannel): ComMBusType=COMM_BUS_TYPE_CAN, ComMChannelId=0
