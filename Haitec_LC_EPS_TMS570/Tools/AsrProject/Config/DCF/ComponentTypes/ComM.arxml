AUTOSAR XML (schema 314)
package /ComponentType
  internal behavior ComM_InternalBehavior: component=ComM
    timing event TMT_ComM_MainFunction_0: start-on-event=ComM_MainFunction_0, period=0.01
    11 x operation invoked event:
      OIT_GetCurrentComMode_UR_ComMUser_CAN00_GetCurrentComMode: start-on-event=GetCurrentComMode, operation=UR_ComMUser_CAN00.GetCurrentComMode
      OIT_GetInhibitionStatus_CL_CAN00_GetInhibitionStatus: start-on-event=GetInhibitionStatus, operation=CL_CAN00.GetInhibitionStatus
      OIT_GetMaxComMode_UR_ComMUser_CAN00_GetMaxComMode: start-on-event=GetMaxComMode, operation=UR_ComMUser_CAN00.GetMaxComMode
      OIT_GetRequestedComMode_UR_ComMUser_CAN00_GetRequestedComMode: start-on-event=GetRequestedComMode, operation=UR_ComMUser_CAN00.GetRequestedComMode
      OIT_LimitChannelToNoComMode_CL_CAN00_LimitChannelToNoComMode: start-on-event=LimitChannelToNoComMode, operation=CL_CAN00.LimitChannelToNoComMode
      OIT_LimitECUToNoComMode_modeLimitation_LimitECUToNoComMode: start-on-event=LimitECUToNoComMode, operation=modeLimitation.LimitECUToNoComMode
      OIT_PreventWakeUp_CW_CAN00_PreventWakeUp: start-on-event=PreventWakeUp, operation=CW_CAN00.PreventWakeUp
      OIT_ReadInhibitCounter_modeLimitation_ReadInhibitCounter: start-on-event=ReadInhibitCounter, operation=modeLimitation.ReadInhibitCounter
      OIT_RequestComMode_UR_ComMUser_CAN00_RequestComMode: start-on-event=RequestComMode, operation=UR_ComMUser_CAN00.RequestComMode
      OIT_ResetInhibitCounter_modeLimitation_ResetInhibitCounter: start-on-event=ResetInhibitCounter, operation=modeLimitation.ResetInhibitCounter
      OIT_SetECUGroupClassification_modeLimitation_SetECUGroupClassification: start-on-event=SetECUGroupClassification, operation=modeLimitation.SetECUGroupClassification
    port-api-options port-api-option={enable-take-address=true, indirect-api=false, port=modeLimitation}:
      port-api-option enable-take-address=true, indirect-api=false, port=CL_CAN00:
        port-arg-values:
          integer literal CL_CAN00: type=ComM_NetworkHandleType, value=0
      port-api-option enable-take-address=true, indirect-api=false, port=CW_CAN00:
        port-arg-values:
          integer literal CW_CAN00: type=ComM_NetworkHandleType, value=0
      port-api-option enable-take-address=true, indirect-api=false, port=UR_ComMUser_CAN00:
        port-arg-values:
          integer literal UR_ComMUser_CAN00: type=ComM_UserHandleType, value=0
    12 x runnable, all with can-be-invoked-concurrently=true:
      ComM_MainFunction_0
      GetCurrentComMode: symbol=ComM_GetCurrentComMode
      GetInhibitionStatus: symbol=ComM_GetInhibitionStatus
      GetMaxComMode: symbol=ComM_GetMaxComMode
      GetRequestedComMode: symbol=ComM_GetRequestedComMode
      LimitChannelToNoComMode: symbol=ComM_ServiceLimitChannelToNoComMode
      LimitECUToNoComMode: symbol=ComM_LimitECUToNoComMode
      PreventWakeUp: symbol=ComM_ServicePreventWakeUp
      ReadInhibitCounter: symbol=ComM_ReadInhibitCounter
      RequestComMode: symbol=ComM_RequestComMode
      ResetInhibitCounter: symbol=ComM_ResetInhibitCounter
      SetECUGroupClassification: symbol=ComM_SetECUGroupClassification
  service component type ComM: category=ServiceComponent
    4 x provide port:
      CL_CAN00: provided-com-specs=[{operation=GetInhibitionStatus, queue-length=1}, {operation=LimitChannelToNoComMode, queue-length=1}], provided-interface=ComM_ChannelLimitation
      CW_CAN00: server-com-spec{operation=PreventWakeUp, queue-length=1}, provided-interface=ComM_ChannelWakeUp
      modeLimitation: provided-interface=ComM_ECUModeLimitation
        provided-com-specs:
          operation=LimitECUToNoComMode, queue-length=1
          operation=ReadInhibitCounter, queue-length=1
          operation=ResetInhibitCounter, queue-length=1
          operation=SetECUGroupClassification, queue-length=1
      UR_ComMUser_CAN00: provided-interface=ComM_UserRequest
        provided-com-specs:
          operation=GetCurrentComMode, queue-length=1
          operation=GetMaxComMode, queue-length=1
          operation=GetRequestedComMode, queue-length=1
          operation=RequestComMode, queue-length=1
  swc implementation ComM_Implementation: behavior=ComM_InternalBehavior
    code-descriptors:
      code Code: type=SRC
