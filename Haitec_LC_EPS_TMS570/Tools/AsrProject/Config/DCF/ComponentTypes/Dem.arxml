AUTOSAR XML (schema 314)
package /ComponentType
  internal behavior Dem_InternalBehavior: component=Dem
    timing event TMT_Dem_MainFunction: start-on-event=Dem_MainFunction, period=0.01
    103 x operation invoked event:
      OIT_GetDTCOfEvent_Event_CTC_0x505100_GetDTCOfEvent: start-on-event=GetDTCOfEvent, operation=Event_CTC_0x505100.GetDTCOfEvent
      OIT_GetDTCOfEvent_Event_CTC_0x505200_GetDTCOfEvent: start-on-event=GetDTCOfEvent, operation=Event_CTC_0x505200.GetDTCOfEvent
      OIT_GetDTCOfEvent_Event_CTC_0x505316_GetDTCOfEvent: start-on-event=GetDTCOfEvent, operation=Event_CTC_0x505316.GetDTCOfEvent
      OIT_GetDTCOfEvent_Event_CTC_0x505317_GetDTCOfEvent: start-on-event=GetDTCOfEvent, operation=Event_CTC_0x505317.GetDTCOfEvent
      OIT_GetDTCOfEvent_Event_CTC_0x505400_GetDTCOfEvent: start-on-event=GetDTCOfEvent, operation=Event_CTC_0x505400.GetDTCOfEvent
      OIT_GetDTCOfEvent_Event_CTC_0x505500_GetDTCOfEvent: start-on-event=GetDTCOfEvent, operation=Event_CTC_0x505500.GetDTCOfEvent
      OIT_GetDTCOfEvent_Event_CTC_0x505600_GetDTCOfEvent: start-on-event=GetDTCOfEvent, operation=Event_CTC_0x505600.GetDTCOfEvent
      OIT_GetDTCOfEvent_Event_CTC_0x505700_GetDTCOfEvent: start-on-event=GetDTCOfEvent, operation=Event_CTC_0x505700.GetDTCOfEvent
      OIT_GetDTCOfEvent_Event_CTC_0x505800_GetDTCOfEvent: start-on-event=GetDTCOfEvent, operation=Event_CTC_0x505800.GetDTCOfEvent
      OIT_GetDTCOfEvent_Event_CTC_0x505900_GetDTCOfEvent: start-on-event=GetDTCOfEvent, operation=Event_CTC_0x505900.GetDTCOfEvent
      OIT_GetDTCOfEvent_Event_CTC_0xD00300_GetDTCOfEvent: start-on-event=GetDTCOfEvent, operation=Event_CTC_0xD00300.GetDTCOfEvent
      OIT_GetDTCOfEvent_Event_CTC_0xD11700_GetDTCOfEvent: start-on-event=GetDTCOfEvent, operation=Event_CTC_0xD11700.GetDTCOfEvent
      OIT_GetDTCOfEvent_Event_CTC_0xD12100_GetDTCOfEvent: start-on-event=GetDTCOfEvent, operation=Event_CTC_0xD12100.GetDTCOfEvent
      OIT_GetDTCOfEvent_Event_CTC_0xD14000_GetDTCOfEvent: start-on-event=GetDTCOfEvent, operation=Event_CTC_0xD14000.GetDTCOfEvent
      OIT_GetEventFailed_Event_CTC_0x505100_GetEventFailed: start-on-event=GetEventFailed, operation=Event_CTC_0x505100.GetEventFailed
      OIT_GetEventFailed_Event_CTC_0x505200_GetEventFailed: start-on-event=GetEventFailed, operation=Event_CTC_0x505200.GetEventFailed
      OIT_GetEventFailed_Event_CTC_0x505316_GetEventFailed: start-on-event=GetEventFailed, operation=Event_CTC_0x505316.GetEventFailed
      OIT_GetEventFailed_Event_CTC_0x505317_GetEventFailed: start-on-event=GetEventFailed, operation=Event_CTC_0x505317.GetEventFailed
      OIT_GetEventFailed_Event_CTC_0x505400_GetEventFailed: start-on-event=GetEventFailed, operation=Event_CTC_0x505400.GetEventFailed
      OIT_GetEventFailed_Event_CTC_0x505500_GetEventFailed: start-on-event=GetEventFailed, operation=Event_CTC_0x505500.GetEventFailed
      OIT_GetEventFailed_Event_CTC_0x505600_GetEventFailed: start-on-event=GetEventFailed, operation=Event_CTC_0x505600.GetEventFailed
      OIT_GetEventFailed_Event_CTC_0x505700_GetEventFailed: start-on-event=GetEventFailed, operation=Event_CTC_0x505700.GetEventFailed
      OIT_GetEventFailed_Event_CTC_0x505800_GetEventFailed: start-on-event=GetEventFailed, operation=Event_CTC_0x505800.GetEventFailed
      OIT_GetEventFailed_Event_CTC_0x505900_GetEventFailed: start-on-event=GetEventFailed, operation=Event_CTC_0x505900.GetEventFailed
      OIT_GetEventFailed_Event_CTC_0xD00300_GetEventFailed: start-on-event=GetEventFailed, operation=Event_CTC_0xD00300.GetEventFailed
      OIT_GetEventFailed_Event_CTC_0xD11700_GetEventFailed: start-on-event=GetEventFailed, operation=Event_CTC_0xD11700.GetEventFailed
      OIT_GetEventFailed_Event_CTC_0xD12100_GetEventFailed: start-on-event=GetEventFailed, operation=Event_CTC_0xD12100.GetEventFailed
      OIT_GetEventFailed_Event_CTC_0xD14000_GetEventFailed: start-on-event=GetEventFailed, operation=Event_CTC_0xD14000.GetEventFailed
      OIT_GetEventStatus_Event_CTC_0x505100_GetEventStatus: start-on-event=GetEventStatus, operation=Event_CTC_0x505100.GetEventStatus
      OIT_GetEventStatus_Event_CTC_0x505200_GetEventStatus: start-on-event=GetEventStatus, operation=Event_CTC_0x505200.GetEventStatus
      OIT_GetEventStatus_Event_CTC_0x505316_GetEventStatus: start-on-event=GetEventStatus, operation=Event_CTC_0x505316.GetEventStatus
      OIT_GetEventStatus_Event_CTC_0x505317_GetEventStatus: start-on-event=GetEventStatus, operation=Event_CTC_0x505317.GetEventStatus
      OIT_GetEventStatus_Event_CTC_0x505400_GetEventStatus: start-on-event=GetEventStatus, operation=Event_CTC_0x505400.GetEventStatus
      OIT_GetEventStatus_Event_CTC_0x505500_GetEventStatus: start-on-event=GetEventStatus, operation=Event_CTC_0x505500.GetEventStatus
      OIT_GetEventStatus_Event_CTC_0x505600_GetEventStatus: start-on-event=GetEventStatus, operation=Event_CTC_0x505600.GetEventStatus
      OIT_GetEventStatus_Event_CTC_0x505700_GetEventStatus: start-on-event=GetEventStatus, operation=Event_CTC_0x505700.GetEventStatus
      OIT_GetEventStatus_Event_CTC_0x505800_GetEventStatus: start-on-event=GetEventStatus, operation=Event_CTC_0x505800.GetEventStatus
      OIT_GetEventStatus_Event_CTC_0x505900_GetEventStatus: start-on-event=GetEventStatus, operation=Event_CTC_0x505900.GetEventStatus
      OIT_GetEventStatus_Event_CTC_0xD00300_GetEventStatus: start-on-event=GetEventStatus, operation=Event_CTC_0xD00300.GetEventStatus
      OIT_GetEventStatus_Event_CTC_0xD11700_GetEventStatus: start-on-event=GetEventStatus, operation=Event_CTC_0xD11700.GetEventStatus
      OIT_GetEventStatus_Event_CTC_0xD12100_GetEventStatus: start-on-event=GetEventStatus, operation=Event_CTC_0xD12100.GetEventStatus
      OIT_GetEventStatus_Event_CTC_0xD14000_GetEventStatus: start-on-event=GetEventStatus, operation=Event_CTC_0xD14000.GetEventStatus
      OIT_GetEventTested_Event_CTC_0x505100_GetEventTested: start-on-event=GetEventTested, operation=Event_CTC_0x505100.GetEventTested
      OIT_GetEventTested_Event_CTC_0x505200_GetEventTested: start-on-event=GetEventTested, operation=Event_CTC_0x505200.GetEventTested
      OIT_GetEventTested_Event_CTC_0x505316_GetEventTested: start-on-event=GetEventTested, operation=Event_CTC_0x505316.GetEventTested
      OIT_GetEventTested_Event_CTC_0x505317_GetEventTested: start-on-event=GetEventTested, operation=Event_CTC_0x505317.GetEventTested
      OIT_GetEventTested_Event_CTC_0x505400_GetEventTested: start-on-event=GetEventTested, operation=Event_CTC_0x505400.GetEventTested
      OIT_GetEventTested_Event_CTC_0x505500_GetEventTested: start-on-event=GetEventTested, operation=Event_CTC_0x505500.GetEventTested
      OIT_GetEventTested_Event_CTC_0x505600_GetEventTested: start-on-event=GetEventTested, operation=Event_CTC_0x505600.GetEventTested
      OIT_GetEventTested_Event_CTC_0x505700_GetEventTested: start-on-event=GetEventTested, operation=Event_CTC_0x505700.GetEventTested
      OIT_GetEventTested_Event_CTC_0x505800_GetEventTested: start-on-event=GetEventTested, operation=Event_CTC_0x505800.GetEventTested
      OIT_GetEventTested_Event_CTC_0x505900_GetEventTested: start-on-event=GetEventTested, operation=Event_CTC_0x505900.GetEventTested
      OIT_GetEventTested_Event_CTC_0xD00300_GetEventTested: start-on-event=GetEventTested, operation=Event_CTC_0xD00300.GetEventTested
      OIT_GetEventTested_Event_CTC_0xD11700_GetEventTested: start-on-event=GetEventTested, operation=Event_CTC_0xD11700.GetEventTested
      OIT_GetEventTested_Event_CTC_0xD12100_GetEventTested: start-on-event=GetEventTested, operation=Event_CTC_0xD12100.GetEventTested
      OIT_GetEventTested_Event_CTC_0xD14000_GetEventTested: start-on-event=GetEventTested, operation=Event_CTC_0xD14000.GetEventTested
      OIT_GetFaultDetectionCounter_Event_CTC_0x505100_GetFaultDetectionCounter: start-on-event=GetFaultDetectionCounter, operation=Event_CTC_0x505100.GetFaultDetectionCounter
      OIT_GetFaultDetectionCounter_Event_CTC_0x505200_GetFaultDetectionCounter: start-on-event=GetFaultDetectionCounter, operation=Event_CTC_0x505200.GetFaultDetectionCounter
      OIT_GetFaultDetectionCounter_Event_CTC_0x505316_GetFaultDetectionCounter: start-on-event=GetFaultDetectionCounter, operation=Event_CTC_0x505316.GetFaultDetectionCounter
      OIT_GetFaultDetectionCounter_Event_CTC_0x505317_GetFaultDetectionCounter: start-on-event=GetFaultDetectionCounter, operation=Event_CTC_0x505317.GetFaultDetectionCounter
      OIT_GetFaultDetectionCounter_Event_CTC_0x505400_GetFaultDetectionCounter: start-on-event=GetFaultDetectionCounter, operation=Event_CTC_0x505400.GetFaultDetectionCounter
      OIT_GetFaultDetectionCounter_Event_CTC_0x505500_GetFaultDetectionCounter: start-on-event=GetFaultDetectionCounter, operation=Event_CTC_0x505500.GetFaultDetectionCounter
      OIT_GetFaultDetectionCounter_Event_CTC_0x505600_GetFaultDetectionCounter: start-on-event=GetFaultDetectionCounter, operation=Event_CTC_0x505600.GetFaultDetectionCounter
      OIT_GetFaultDetectionCounter_Event_CTC_0x505700_GetFaultDetectionCounter: start-on-event=GetFaultDetectionCounter, operation=Event_CTC_0x505700.GetFaultDetectionCounter
      OIT_GetFaultDetectionCounter_Event_CTC_0x505800_GetFaultDetectionCounter: start-on-event=GetFaultDetectionCounter, operation=Event_CTC_0x505800.GetFaultDetectionCounter
      OIT_GetFaultDetectionCounter_Event_CTC_0x505900_GetFaultDetectionCounter: start-on-event=GetFaultDetectionCounter, operation=Event_CTC_0x505900.GetFaultDetectionCounter
      OIT_GetFaultDetectionCounter_Event_CTC_0xD00300_GetFaultDetectionCounter: start-on-event=GetFaultDetectionCounter, operation=Event_CTC_0xD00300.GetFaultDetectionCounter
      OIT_GetFaultDetectionCounter_Event_CTC_0xD11700_GetFaultDetectionCounter: start-on-event=GetFaultDetectionCounter, operation=Event_CTC_0xD11700.GetFaultDetectionCounter
      OIT_GetFaultDetectionCounter_Event_CTC_0xD12100_GetFaultDetectionCounter: start-on-event=GetFaultDetectionCounter, operation=Event_CTC_0xD12100.GetFaultDetectionCounter
      OIT_GetFaultDetectionCounter_Event_CTC_0xD14000_GetFaultDetectionCounter: start-on-event=GetFaultDetectionCounter, operation=Event_CTC_0xD14000.GetFaultDetectionCounter
      OIT_GetIndicatorStatus_IndStatus_EpasFailed_GetIndicatorStatus: start-on-event=GetIndicatorStatus, operation=IndStatus_EpasFailed.GetIndicatorStatus
      OIT_ResetEventStatus_Event_CTC_0x505100_ResetEventStatus: start-on-event=ResetEventStatus, operation=Event_CTC_0x505100.ResetEventStatus
      OIT_ResetEventStatus_Event_CTC_0x505200_ResetEventStatus: start-on-event=ResetEventStatus, operation=Event_CTC_0x505200.ResetEventStatus
      OIT_ResetEventStatus_Event_CTC_0x505316_ResetEventStatus: start-on-event=ResetEventStatus, operation=Event_CTC_0x505316.ResetEventStatus
      OIT_ResetEventStatus_Event_CTC_0x505317_ResetEventStatus: start-on-event=ResetEventStatus, operation=Event_CTC_0x505317.ResetEventStatus
      OIT_ResetEventStatus_Event_CTC_0x505400_ResetEventStatus: start-on-event=ResetEventStatus, operation=Event_CTC_0x505400.ResetEventStatus
      OIT_ResetEventStatus_Event_CTC_0x505500_ResetEventStatus: start-on-event=ResetEventStatus, operation=Event_CTC_0x505500.ResetEventStatus
      OIT_ResetEventStatus_Event_CTC_0x505600_ResetEventStatus: start-on-event=ResetEventStatus, operation=Event_CTC_0x505600.ResetEventStatus
      OIT_ResetEventStatus_Event_CTC_0x505700_ResetEventStatus: start-on-event=ResetEventStatus, operation=Event_CTC_0x505700.ResetEventStatus
      OIT_ResetEventStatus_Event_CTC_0x505800_ResetEventStatus: start-on-event=ResetEventStatus, operation=Event_CTC_0x505800.ResetEventStatus
      OIT_ResetEventStatus_Event_CTC_0x505900_ResetEventStatus: start-on-event=ResetEventStatus, operation=Event_CTC_0x505900.ResetEventStatus
      OIT_ResetEventStatus_Event_CTC_0xD00300_ResetEventStatus: start-on-event=ResetEventStatus, operation=Event_CTC_0xD00300.ResetEventStatus
      OIT_ResetEventStatus_Event_CTC_0xD11700_ResetEventStatus: start-on-event=ResetEventStatus, operation=Event_CTC_0xD11700.ResetEventStatus
      OIT_ResetEventStatus_Event_CTC_0xD12100_ResetEventStatus: start-on-event=ResetEventStatus, operation=Event_CTC_0xD12100.ResetEventStatus
      OIT_ResetEventStatus_Event_CTC_0xD14000_ResetEventStatus: start-on-event=ResetEventStatus, operation=Event_CTC_0xD14000.ResetEventStatus
      OIT_SetEventStatus_Event_CTC_0x505100_SetEventStatus: start-on-event=SetEventStatus, operation=Event_CTC_0x505100.SetEventStatus
      OIT_SetEventStatus_Event_CTC_0x505200_SetEventStatus: start-on-event=SetEventStatus, operation=Event_CTC_0x505200.SetEventStatus
      OIT_SetEventStatus_Event_CTC_0x505316_SetEventStatus: start-on-event=SetEventStatus, operation=Event_CTC_0x505316.SetEventStatus
      OIT_SetEventStatus_Event_CTC_0x505317_SetEventStatus: start-on-event=SetEventStatus, operation=Event_CTC_0x505317.SetEventStatus
      OIT_SetEventStatus_Event_CTC_0x505400_SetEventStatus: start-on-event=SetEventStatus, operation=Event_CTC_0x505400.SetEventStatus
      OIT_SetEventStatus_Event_CTC_0x505500_SetEventStatus: start-on-event=SetEventStatus, operation=Event_CTC_0x505500.SetEventStatus
      OIT_SetEventStatus_Event_CTC_0x505600_SetEventStatus: start-on-event=SetEventStatus, operation=Event_CTC_0x505600.SetEventStatus
      OIT_SetEventStatus_Event_CTC_0x505700_SetEventStatus: start-on-event=SetEventStatus, operation=Event_CTC_0x505700.SetEventStatus
      OIT_SetEventStatus_Event_CTC_0x505800_SetEventStatus: start-on-event=SetEventStatus, operation=Event_CTC_0x505800.SetEventStatus
      OIT_SetEventStatus_Event_CTC_0x505900_SetEventStatus: start-on-event=SetEventStatus, operation=Event_CTC_0x505900.SetEventStatus
      OIT_SetEventStatus_Event_CTC_0xD00300_SetEventStatus: start-on-event=SetEventStatus, operation=Event_CTC_0xD00300.SetEventStatus
      OIT_SetEventStatus_Event_CTC_0xD11700_SetEventStatus: start-on-event=SetEventStatus, operation=Event_CTC_0xD11700.SetEventStatus
      OIT_SetEventStatus_Event_CTC_0xD12100_SetEventStatus: start-on-event=SetEventStatus, operation=Event_CTC_0xD12100.SetEventStatus
      OIT_SetEventStatus_Event_CTC_0xD14000_SetEventStatus: start-on-event=SetEventStatus, operation=Event_CTC_0xD14000.SetEventStatus
      OIT_SetOperationCycleState_OpCycle_DEM_IGNITION_SetOperationCycleState: start-on-event=SetOperationCycleState, operation=OpCycle_DEM_IGNITION.SetOperationCycleState
      OIT_SetOperationCycleState_OpCycle_DEM_OBD_DCY_SetOperationCycleState: start-on-event=SetOperationCycleState, operation=OpCycle_DEM_OBD_DCY.SetOperationCycleState
      OIT_SetOperationCycleState_OpCycle_DEM_POWER_SetOperationCycleState: start-on-event=SetOperationCycleState, operation=OpCycle_DEM_POWER.SetOperationCycleState
      OIT_SetOperationCycleState_OpCycle_DEM_WARMUP_SetOperationCycleState: start-on-event=SetOperationCycleState, operation=OpCycle_DEM_WARMUP.SetOperationCycleState
    port-api-option enable-take-address=true, indirect-api=false, port=Event_CTC_0x505100:
      port-arg-values:
        integer literal Event_CTC_0x505100: type=Dem_EventIdType, value=14
    port-api-option enable-take-address=true, indirect-api=false, port=Event_CTC_0x505200:
      port-arg-values:
        integer literal Event_CTC_0x505200: type=Dem_EventIdType, value=13
    port-api-option enable-take-address=true, indirect-api=false, port=Event_CTC_0x505316:
      port-arg-values:
        integer literal Event_CTC_0x505316: type=Dem_EventIdType, value=12
    port-api-option enable-take-address=true, indirect-api=false, port=Event_CTC_0x505317:
      port-arg-values:
        integer literal Event_CTC_0x505317: type=Dem_EventIdType, value=11
    port-api-option enable-take-address=true, indirect-api=false, port=Event_CTC_0x505400:
      port-arg-values:
        integer literal Event_CTC_0x505400: type=Dem_EventIdType, value=10
    port-api-option enable-take-address=true, indirect-api=false, port=Event_CTC_0x505500:
      port-arg-values:
        integer literal Event_CTC_0x505500: type=Dem_EventIdType, value=9
    port-api-option enable-take-address=true, indirect-api=false, port=Event_CTC_0x505600:
      port-arg-values:
        integer literal Event_CTC_0x505600: type=Dem_EventIdType, value=8
    port-api-option enable-take-address=true, indirect-api=false, port=Event_CTC_0x505700:
      port-arg-values:
        integer literal Event_CTC_0x505700: type=Dem_EventIdType, value=7
    port-api-option enable-take-address=true, indirect-api=false, port=Event_CTC_0x505800:
      port-arg-values:
        integer literal Event_CTC_0x505800: type=Dem_EventIdType, value=6
    port-api-option enable-take-address=true, indirect-api=false, port=Event_CTC_0x505900:
      port-arg-values:
        integer literal Event_CTC_0x505900: type=Dem_EventIdType, value=5
    port-api-option enable-take-address=true, indirect-api=false, port=Event_CTC_0xD00300:
      port-arg-values:
        integer literal Event_CTC_0xD00300: type=Dem_EventIdType, value=4
    port-api-option enable-take-address=true, indirect-api=false, port=Event_CTC_0xD11700:
      port-arg-values:
        integer literal Event_CTC_0xD11700: type=Dem_EventIdType, value=3
    port-api-option enable-take-address=true, indirect-api=false, port=Event_CTC_0xD12100:
      port-arg-values:
        integer literal Event_CTC_0xD12100: type=Dem_EventIdType, value=2
    port-api-option enable-take-address=true, indirect-api=false, port=Event_CTC_0xD14000:
      port-arg-values:
        integer literal Event_CTC_0xD14000: type=Dem_EventIdType, value=1
    port-api-option enable-take-address=true, indirect-api=false, port=IndStatus_EpasFailed:
      port-arg-values:
        integer literal IndStatus_EpasFailed: type=UInt8, value=0
    port-api-option enable-take-address=true, indirect-api=false, port=OpCycle_DEM_IGNITION:
      port-arg-values:
        integer literal OpCycle_DEM_IGNITION: type=Dem_OperationCycleIdType, value=0
    port-api-option enable-take-address=true, indirect-api=false, port=OpCycle_DEM_OBD_DCY:
      port-arg-values:
        integer literal OpCycle_DEM_OBD_DCY: type=Dem_OperationCycleIdType, value=1
    port-api-option enable-take-address=true, indirect-api=false, port=OpCycle_DEM_POWER:
      port-arg-values:
        integer literal OpCycle_DEM_POWER: type=Dem_OperationCycleIdType, value=3
    port-api-option enable-take-address=true, indirect-api=false, port=OpCycle_DEM_WARMUP:
      port-arg-values:
        integer literal OpCycle_DEM_WARMUP: type=Dem_OperationCycleIdType, value=2
    10 x runnable:
      Dem_MainFunction
      GetDTCOfEvent: can-be-invoked-concurrently=true, symbol=Dem_GetDTCOfEvent
      GetEventFailed: can-be-invoked-concurrently=true, symbol=Dem_GetEventFailed
      GetEventStatus: can-be-invoked-concurrently=true, symbol=Dem_GetEventStatus
      GetEventTested: can-be-invoked-concurrently=true, symbol=Dem_GetEventTested
      GetFaultDetectionCounter: can-be-invoked-concurrently=true, symbol=Dem_GetFaultDetectionCounter
      GetIndicatorStatus: can-be-invoked-concurrently=true, symbol=Dem_GetIndicatorStatus
      ResetEventStatus: can-be-invoked-concurrently=true, symbol=Dem_ResetEventStatus
      SetEventStatus: can-be-invoked-concurrently=true, symbol=Dem_SetEventStatus
      SetOperationCycleState: can-be-invoked-concurrently=true, symbol=Dem_SetOperationCycleState
  service component type Dem: category=ServiceComponent
    19 x provide port:
      Event_CTC_0x505100: provided-interface=DiagnosticMonitor
        provided-com-specs:
          operation=GetDTCOfEvent, queue-length=1
          operation=GetEventFailed, queue-length=1
          operation=GetEventStatus, queue-length=1
          operation=GetEventTested, queue-length=1
          operation=GetFaultDetectionCounter, queue-length=1
          operation=ResetEventStatus, queue-length=1
          operation=SetEventStatus, queue-length=1
      Event_CTC_0x505200: provided-interface=DiagnosticMonitor
        provided-com-specs:
          operation=GetDTCOfEvent, queue-length=1
          operation=GetEventFailed, queue-length=1
          operation=GetEventStatus, queue-length=1
          operation=GetEventTested, queue-length=1
          operation=GetFaultDetectionCounter, queue-length=1
          operation=ResetEventStatus, queue-length=1
          operation=SetEventStatus, queue-length=1
      Event_CTC_0x505316: provided-interface=DiagnosticMonitor
        provided-com-specs:
          operation=GetDTCOfEvent, queue-length=1
          operation=GetEventFailed, queue-length=1
          operation=GetEventStatus, queue-length=1
          operation=GetEventTested, queue-length=1
          operation=GetFaultDetectionCounter, queue-length=1
          operation=ResetEventStatus, queue-length=1
          operation=SetEventStatus, queue-length=1
      Event_CTC_0x505317: provided-interface=DiagnosticMonitor
        provided-com-specs:
          operation=GetDTCOfEvent, queue-length=1
          operation=GetEventFailed, queue-length=1
          operation=GetEventStatus, queue-length=1
          operation=GetEventTested, queue-length=1
          operation=GetFaultDetectionCounter, queue-length=1
          operation=ResetEventStatus, queue-length=1
          operation=SetEventStatus, queue-length=1
      Event_CTC_0x505400: provided-interface=DiagnosticMonitor
        provided-com-specs:
          operation=GetDTCOfEvent, queue-length=1
          operation=GetEventFailed, queue-length=1
          operation=GetEventStatus, queue-length=1
          operation=GetEventTested, queue-length=1
          operation=GetFaultDetectionCounter, queue-length=1
          operation=ResetEventStatus, queue-length=1
          operation=SetEventStatus, queue-length=1
      Event_CTC_0x505500: provided-interface=DiagnosticMonitor
        provided-com-specs:
          operation=GetDTCOfEvent, queue-length=1
          operation=GetEventFailed, queue-length=1
          operation=GetEventStatus, queue-length=1
          operation=GetEventTested, queue-length=1
          operation=GetFaultDetectionCounter, queue-length=1
          operation=ResetEventStatus, queue-length=1
          operation=SetEventStatus, queue-length=1
      Event_CTC_0x505600: provided-interface=DiagnosticMonitor
        provided-com-specs:
          operation=GetDTCOfEvent, queue-length=1
          operation=GetEventFailed, queue-length=1
          operation=GetEventStatus, queue-length=1
          operation=GetEventTested, queue-length=1
          operation=GetFaultDetectionCounter, queue-length=1
          operation=ResetEventStatus, queue-length=1
          operation=SetEventStatus, queue-length=1
      Event_CTC_0x505700: provided-interface=DiagnosticMonitor
        provided-com-specs:
          operation=GetDTCOfEvent, queue-length=1
          operation=GetEventFailed, queue-length=1
          operation=GetEventStatus, queue-length=1
          operation=GetEventTested, queue-length=1
          operation=GetFaultDetectionCounter, queue-length=1
          operation=ResetEventStatus, queue-length=1
          operation=SetEventStatus, queue-length=1
      Event_CTC_0x505800: provided-interface=DiagnosticMonitor
        provided-com-specs:
          operation=GetDTCOfEvent, queue-length=1
          operation=GetEventFailed, queue-length=1
          operation=GetEventStatus, queue-length=1
          operation=GetEventTested, queue-length=1
          operation=GetFaultDetectionCounter, queue-length=1
          operation=ResetEventStatus, queue-length=1
          operation=SetEventStatus, queue-length=1
      Event_CTC_0x505900: provided-interface=DiagnosticMonitor
        provided-com-specs:
          operation=GetDTCOfEvent, queue-length=1
          operation=GetEventFailed, queue-length=1
          operation=GetEventStatus, queue-length=1
          operation=GetEventTested, queue-length=1
          operation=GetFaultDetectionCounter, queue-length=1
          operation=ResetEventStatus, queue-length=1
          operation=SetEventStatus, queue-length=1
      Event_CTC_0xD00300: provided-interface=DiagnosticMonitor
        provided-com-specs:
          operation=GetDTCOfEvent, queue-length=1
          operation=GetEventFailed, queue-length=1
          operation=GetEventStatus, queue-length=1
          operation=GetEventTested, queue-length=1
          operation=GetFaultDetectionCounter, queue-length=1
          operation=ResetEventStatus, queue-length=1
          operation=SetEventStatus, queue-length=1
      Event_CTC_0xD11700: provided-interface=DiagnosticMonitor
        provided-com-specs:
          operation=GetDTCOfEvent, queue-length=1
          operation=GetEventFailed, queue-length=1
          operation=GetEventStatus, queue-length=1
          operation=GetEventTested, queue-length=1
          operation=GetFaultDetectionCounter, queue-length=1
          operation=ResetEventStatus, queue-length=1
          operation=SetEventStatus, queue-length=1
      Event_CTC_0xD12100: provided-interface=DiagnosticMonitor
        provided-com-specs:
          operation=GetDTCOfEvent, queue-length=1
          operation=GetEventFailed, queue-length=1
          operation=GetEventStatus, queue-length=1
          operation=GetEventTested, queue-length=1
          operation=GetFaultDetectionCounter, queue-length=1
          operation=ResetEventStatus, queue-length=1
          operation=SetEventStatus, queue-length=1
      Event_CTC_0xD14000: provided-interface=DiagnosticMonitor
        provided-com-specs:
          operation=GetDTCOfEvent, queue-length=1
          operation=GetEventFailed, queue-length=1
          operation=GetEventStatus, queue-length=1
          operation=GetEventTested, queue-length=1
          operation=GetFaultDetectionCounter, queue-length=1
          operation=ResetEventStatus, queue-length=1
          operation=SetEventStatus, queue-length=1
      IndStatus_EpasFailed: server-com-spec{operation=GetIndicatorStatus, queue-length=1}, provided-interface=IndicatorStatus
      OpCycle_DEM_IGNITION: server-com-spec{operation=SetOperationCycleState, queue-length=1}, provided-interface=OperationCycle
      OpCycle_DEM_OBD_DCY: server-com-spec{operation=SetOperationCycleState, queue-length=1}, provided-interface=OperationCycle
      OpCycle_DEM_POWER: server-com-spec{operation=SetOperationCycleState, queue-length=1}, provided-interface=OperationCycle
      OpCycle_DEM_WARMUP: server-com-spec{operation=SetOperationCycleState, queue-length=1}, provided-interface=OperationCycle
  swc implementation Dem_Implementation: behavior=Dem_InternalBehavior
    code-descriptors:
      code Code: type=SRC
